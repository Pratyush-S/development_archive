----------------------------------------------------------------------------------
-- Company: 
-- Engineer: 
-- 
-- Create Date: 23.03.2025 01:21:36
-- Design Name: 
-- Module Name: VHDL_SPI_MASTER - Behavioral
-- Project Name: 
-- Target Devices: 
-- Tool Versions: 
-- Description: 
-- 
-- Dependencies: 
-- 
-- Revision:
-- Revision 0.01 - File Created
-- Additional Comments:
-- 
----------------------------------------------------------------------------------


library IEEE;
use IEEE.STD_LOGIC_1164.ALL;

-- Uncomment the following library declaration if using
-- arithmetic functions with Signed or Unsigned values
use IEEE.NUMERIC_STD.ALL;

-- Uncomment the following library declaration if instantiating
-- any Xilinx leaf cells in this code.
--library UNISIM;
--use UNISIM.VComponents.all;

entity VHDL_SPI_MASTER is
   Port (
        clk      : in  std_logic;
        bit_out      : out  std_logic
            
    );
end VHDL_SPI_MASTER;

architecture Behavioral of VHDL_SPI_MASTER is


    -- Define an array type for storing byte values (0-255)
    type bit_array is array (0 to 399) of std_logic;
    
  
    -- Define a constant array with the given values
    constant my_values2 : bit_array := ('1' , '0' , '0' , '1' , '0' , '1' , '0' , '0' , '0' , '0' , '0' , '0' , '0' , '0' , '0' , '0' , 
    '0' , '0' , '0' , '0' , '0' , '0' , '0' , '0' , '1' , '1' , '0' , '1' , '0' , '1' , '0' , '0' , '0' , '1' , '0' , '1' , '0' , '0' , 
    '0' , '0' , '0' , '0' , '0' , '0' , '0' , '0' , '0' , '0' , '1' , '1' , '0' , '1' , '0' , '1' , '0' , '0' , '0' , '0' , '0' , '1' , 
    '0' , '0' , '0' , '0' , '0' , '0' , '0' , '0' , '0' , '0' , '0' , '0' , '1' , '1' , '0' , '1' , '0' , '1' , '0' , '0' , '0' , '0' , 
    '0' , '1' , '0' , '0' , '0' , '0' , '0' , '0' , '0' , '0' , '0' , '0' , '1' , '0' , '1' , '1' , '1' , '0' , '0' , '0' , '1' , '0' , 
    '0' , '0' , '0' , '1' , '0' , '0' , '0' , '1' , '1' , '1' , '1' , '1' , '1' , '1' , '1' , '1' , '0' , '0' , '0' , '0' , '0' , '0' , 
    '1' , '1' , '1' , '0' , '1' , '0' , '0' , '0' , '1' , '0' , '0' , '0' , '0' , '0' , '0' , '0' , '0' , '0' , '1' , '1' , '0' , '0' , 
    '1' , '0' , '1' , '0' , '0' , '0' , '0' , '0' , '0' , '0' , '1' , '1' , '0' , '0' , '1' , '1' , '1' , '1' , '1' , '1' , '1' , '1' , 
    '1' , '1' , '0' , '0' , '0' , '0' , '1' , '1' , '1' , '1' , '1' , '1' , '1' , '1' , '1' , '1' , '1' , '1' , '1' , '1' , '1' , '1' , 
    '0' , '1' , '0' , '0' , '0' , '0' , '0' , '0' , '0' , '0' , '0' , '0' , '0' , '0' , '1' , '0' , '0' , '0' , '0' , '0' , '0' , '0' , 
    '0' , '0' , '0' , '0' , '0' , '0' , '0' , '0' , '0' , '0' , '1' , '1' , '1' , '0' , '0' , '0' , '1' , '0' , '0' , '0' , '0' , '1' , 
    '0' , '0' , '1' , '1' , '1' , '1' , '1' , '1' , '1' , '1' , '1' , '1' , '1' , '1' , '1' , '1' , '1' , '1' , '1' , '1' , '1' , '1' , 
    '1' , '1' , '1' , '1' , '1' , '1' , '1' , '1' , '1' , '1' , '1' , '1' , '1' , '1' , '0' , '0' , '0' , '0' , '0' , '0' , '0' , '0' , 
    '0' , '0' , '0' , '0' , '0' , '0' , '0' , '0' , '1' , '0' , '0' , '0' , '0' , '1' , '0' , '0' , '0' , '0' , '0' , '0' , '0' , '0' , 
    '0' , '0' , '1' , '1' , '1' , '0' , '0' , '0' , '1' , '0' , '0' , '1' , '0' , '1' , '1' , '0' , '0' , '0' , '0' , '0' , '0' , '1' , 
    '0' , '0' , '0' , '0' , '0' , '0' , '0' , '0' , '0' , '0' , '0' , '1' , '0' , '0' , '0' , '0' , '1' , '1' , '1' , '1' , '0' , '0' , 
    '0' , '0' , '0' , '0' , '0' , '0' , '1' , '1' , '1' , '0' , '0' , '0' , '1' , '0' , '0' , '1' , '0' , '1' , '1' , '0' , '0' , '0' , 
    '0' , '0' , '0' , '1' , '0' , '0' , '0' , '0' , '0' , '0' , '0' , '0' , '0' , '0' , '0' , '1' , '0' , '0' , '0' , '0' , '0' , '0' , 
    '0' , '0' , '0' , '0' , '0' , '0' , '0' , '0' , '0' , '0' );


    signal primary_index : integer  := 0;
    

begin

process (clk)
    begin
        if rising_edge(clk) then
           
           if(primary_index<50) then
               bit_out <=  my_values2(primary_index);
               primary_index <= primary_index+1;
           end if;    
           
        end if;
    end process;

end Behavioral;

























